#include <SPI.h>
#include <Ethernet.h>

#include <Wire.h>
#include <SeeedOLED.h>
#include <avr/pgmspace.h>

static unsigned char url[] PROGMEM ={
0x00, 0x00, 0x00, 0x00, 0x00, 0x00, 0x00, 0x00, 0x00, 0x00, 0x00, 0x00, 0x00, 0x00, 0x00, 0x00,
0x00, 0x00, 0x00, 0x00, 0x00, 0x00, 0x00, 0x00, 0xFF, 0xFF, 0xFF, 0xFF, 0xFF, 0xFF, 0xFF, 0xFF,
0xFF, 0xFF, 0xFF, 0xFF, 0xFF, 0xFF, 0xFF, 0xFF, 0xFF, 0xFF, 0xFF, 0xFF, 0xFF, 0xFF, 0xFF, 0xFF,
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0x00, 0x00, 0x00, 0x00, 0x00, 0x00, 0x00, 0x00, 0x00, 0x00, 0x00, 0x00, 0x00, 0x00, 0x00, 0x00
};

int pin = 8;
unsigned long duration;
unsigned long starttime;
unsigned long sampletime_ms = 30000;//sampe 30s ;
unsigned long lowpulseoccupancy = 0;
float ratio = 0;
float concentration = 0;

byte mac[] = { 
  0xDE, 0xAD, 0xBE, 0xEF, 0xFE, 0xED };
IPAddress ip(192,168,0,101); //jaga
//IPAddress ip(192,168,0,100); //ghar

// Initialize the Ethernet server library
// with the IP address and port you want to use 
// (port 80 is default for HTTP):
EthernetServer server(80);

void setup()
{
  Serial.begin(9600);
  //pinMode(CS_pin, OUTPUT);
  Wire.begin();
  SeeedOled.init();  //initialze SEEED OLED display
  DDRB|=0x21;        
  PORTB |= 0x21;
  SeeedOled.clearDisplay();          //clear the screen and set start position to top left corner
  SeeedOled.setNormalDisplay();      //Set display to normal mode (i.e non-inverse mode)
  SeeedOled.setPageMode(); 
  SeeedOled.drawBitmap(url,1024);   // 1024 = 128 Pixels * 64 Pixels / 8  //Set addressing mode to Page Mode
  SeeedOled.setTextXY(4, 10);          //Set the cursor to Xth Page, Yth Column  
  SeeedOled.putString("Hello"); //Print the String
  SeeedOled.setTextXY(6, 10);          //Set the cursor to Xth Page, Yth Column  
  SeeedOled.putString("Folks"); //Print the String
  delay(5000);
  SeeedOled.clearDisplay();
  SeeedOled.setTextXY(2, 4);
  SeeedOled.putString("Pollution");
  SeeedOled.setTextXY(4, 4);
  SeeedOled.putString("Recorder");
  delay(2000);
  SeeedOled.clearDisplay();
  SeeedOled.setTextXY(3, 0);
  SeeedOled.putString("Measuring...");
 // SeeedOled.setHorizontalScrollProperties(Scroll_Right,3,0,Scroll_5Frames); //Set Scrolling properties to Scroll Right
 // SeeedOled.deactivateScroll();             // Activate Scrolling
  
  pinMode(8,INPUT);
  starttime = millis();//get the current time;
  pinMode(7, OUTPUT);
  digitalWrite(7, HIGH);
  
  // start the Ethernet connection and the server:
  Ethernet.begin(mac, ip);
  server.begin();
  Serial.print("server is at ");
  Serial.println(Ethernet.localIP());
}

void loop() 
{
  duration = pulseIn(pin, LOW);
  lowpulseoccupancy = lowpulseoccupancy+duration;
  
  if ((millis()-starttime) > sampletime_ms)//if the sampel time == 30s
  {
    ratio = lowpulseoccupancy/(sampletime_ms*10.0);  // Integer percentage 0=>100
    concentration = 1.1*pow(ratio,3)-3.8*pow(ratio,2)+520*ratio+0.62; // using spec sheet curve
   
    Serial.print("Lowpulseoccupancy: ");
    Serial.print(lowpulseoccupancy);
    Serial.println("Ratio: ");
    Serial.print(ratio);
    Serial.println("Conc.: ");
    Serial.print(concentration);
    Serial.println();
    
    lowpulseoccupancy = 0;
    starttime = millis();
    
    SeeedOled.clearDisplay();
    //SeeedOled.deactivateScroll();
    SeeedOled.setTextXY(0, 0);
    SeeedOled.putString("Dust Conc.");
    SeeedOled.setTextXY(2, 0);
    SeeedOled.putString("in pcs/283ml:");
    SeeedOled.setTextXY(4, 1);
    SeeedOled.putFloat(concentration);
  }
  
  // listen for incoming clients
  EthernetClient client = server.available();
  if (client) 
  {
    // an http request ends with a blank line
    boolean currentLineIsBlank = true;
    while (client.connected()) 
    {
      if (client.available()) 
      {
        char c = client.read();
        // if you've gotten to the end of the line (received a newline
        // character) and the line is blank, the http request has ended,
        // so you can send a reply
        if (c == '\n' && currentLineIsBlank)
        {
          // send a standard http response header
          client.println("HTTP/1.1 200 OK");
          client.println("Content-Type: text/html");
          client.println("Connection: close");  // the connection will be closed after completion of the response
	  client.println("Refresh: 5");  // refresh the page automatically every 5 sec
          client.println();
          client.println("<!DOCTYPE HTML>");
          client.println("<html>");
          client.println("Dust Concentration(in pcs/283ml): ");
          client.print(concentration);
          client.println("<br />");
          client.println("</html>");
          break;
        }
     if (c == '\n') {
          // you're starting a new line
          currentLineIsBlank = true;
        } 
        else if (c != '\r') {
          // you've gotten a character on the current line
          currentLineIsBlank = false;
        }
       }
    }
    // give the web browser time to receive the data
    delay(1);
    // close the connection:
    client.stop();
    Serial.println("client disonnected");
  }
}
